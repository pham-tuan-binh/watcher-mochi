## components/sensecap-watcher/Kconfig
```kconfig
menu "SenseCAP Watcher BSP Configuration"

    config BSP_ERROR_CHECK
    bool "Enable error check in BSP"
    default y
    help
        Error check assert the application before returning the error code.

    config BSP_AUDIO_MIC_VALUE_GAIN
    int "Audio mic value gain"
    range 0 3
    default 0
    help
        "Audio mic value gain"

    config BSP_LCD_DEFAULT_BRIGHTNESS
    int "LCD default brightness"
    range 0 100
    default 100
    help
        "LCD default brightness"

    config BSP_LCD_PANEL_SPI_TRANS_Q_DEPTH
        int "LCD panel SPI trans_queue_depth"
        range 1 2
        default 2
        help
            "LCD panel SPI config trans_queue_depth"

    config BSP_LCD_SPI_DMA_SIZE_DIV
        int "LCD panel SPI DMA buffer size divider"
        range 1 64
        default 1
        help
            Setting this value greater than 1 to reduce the DMA buffer size for LCD panel's SPI transfer.
            The divider is applied to the buffer which can just contain the full screen pixels data.

    menu "BSP LVGL Configuration"

        config LVGL_DRAW_BUFF_HEIGHT
            int "LVGL DRAW BUFF HEIGHT(ROWS)"
            range 40 412
            default 412
            help
                "LVGL draw buffer height(rows)"

        config LVGL_PORT_TASK_STACK_SIZE
            int "LVGL TASK STACK SIZE"
            range 4096 40960
            default 10240
            help
                "LVGL task stack size"

        config LVGL_PORT_TASK_PRIORITY
            int "LVGL TASK PRIORITY"
            range 1 25
            default 4
            help
                "LVGL task priority"

        choice LVGL_PORT_TASK_AFFINITY
            prompt "LVGL TASK AFFINITY"
            default LVGL_PORT_TASK_AFFINITY_NO_AFFINTY
            help
                Configure the "LVGL task" core affinity.

            config LVGL_PORT_TASK_AFFINITY_CPU0
                bool "CPU0"
            config LVGL_PORT_TASK_AFFINITY_CPU1
                bool "CPU1"
                depends on !FREERTOS_UNICORE
            config LVGL_PORT_TASK_AFFINITY_NO_AFFINTY
                bool "No affinity"
        endchoice

        config LVGL_PORT_TASK_AFFINITY
            int
            default 0 if LVGL_PORT_TASK_AFFINITY_CPU0
            default 1 if LVGL_PORT_TASK_AFFINITY_CPU1
            default -1 if LVGL_PORT_TASK_AFFINITY_NO_AFFINTY


        config LVGL_PORT_TASK_STACK_ALLOC_EXTERNAL
            bool "LVGL TASK STACK ALLOC EXTERNAL"
            default n
            select SPIRAM_ALLOW_STACK_EXTERNAL_MEMORY
            help
                "Enable this option to allocate the task stack from external memory by default"

        config LVGL_INPUT_DEVICE_USE_KNOB
            bool "LVGL INPUT DEVICE USE KNOB"
            default y
            help
                "Enable to use knob as LVGL input device"

        config LVGL_INPUT_DEVICE_USE_TP
            bool "LVGL INPUT DEVICE USE TP"
            default y
            help
                "Enable to use touchpad as LVGL input device"

        config LVGL_INPUT_DEVICE_SENSITIVITY
            int "LVGL INPUT DEVICE SENSITIVITY"
            default -1
            depends on LVGL_INPUT_DEVICE_USE_TP
            help
                "Set the sensitivity of LVGL input device"
        
        config LVGL_PORT_TASK_MAX_SLEEP_MS
            int "LVGL TASK MAX SLEEP MS"
            range 1 1000
            default 500
            help
                "LVGL task max sleep ms"

        config LVGL_PORT_TIMER_PERIOD_MS
            int "LVGL TIMER PERIOD MS"
            range 1 100
            default 5
            help
                "LVGL timer period ms"
    endmenu


    menu "SSCMA Client Configuration"

        config SSCMA_ENABLE_DEBUG_LOG
            bool "Enable debug log"
                default n
                help
                    Wether to enable the debug log message for SSCMA Client driver.
                    Note that, this option only controls the SSCMA Client driver log, won't affect other drivers.


        config SSCMA_EVENT_QUEUE_SIZE
            int "SSCMA Client event queue size"
            range 1 10
            default 2
            help
                Config SSCMA Client event queue size

        config SSCMA_TX_BUFFER_SIZE
            int "SSCMA Client TX Buffer Size"
            range 4096 10240
            default 8192
            help
                Config SSCMA TX buffer size

        config SSCMA_RX_BUFFER_SIZE
            int "SSCMA Client RX Buffer Size"
            range 32768 131072
            default 98304
            help
                Config SSCMA RX buffer size

        menu "SSCMA Client Process Task"
            config SSCMA_PROCESS_TASK_STACK_SIZE
                int "Stack Size"
                range 4096 10240
                default 4096
                help
                    Config process task stack size in different applications

            config SSCMA_PROCESS_TASK_PRIORITY
                int "Task Priority"
                range 1 25
                default 5
                help
                    Sets the process task priority

            choice SSCMA_PROCESS_TASK_AFFINITY
                prompt "Core Affinity"
                default SSCMA_PROCESS_TASK_AFFINITY_NO_AFFINTY
                help
                    Configure the "process task" core affinity.

                config SSCMA_PROCESS_TASK_AFFINITY_CPU0
                    bool "CPU0"
                config SSCMA_PROCESS_TASK_AFFINITY_CPU1
                    bool "CPU1"
                    depends on !FREERTOS_UNICORE
                config SSCMA_PROCESS_TASK_AFFINITY_NO_AFFINTY
                    bool "No affinity"
            endchoice

            config SSCMA_PROCESS_TASK_AFFINITY
                int
                default 0 if SSCMA_PROCESS_TASK_AFFINITY_CPU0
                default 1 if SSCMA_PROCESS_TASK_AFFINITY_CPU1
                default -1 if SSCMA_PROCESS_TASK_AFFINITY_NO_AFFINTY

            config SSCMA_PROCESS_TASK_STACK_ALLOC_EXTERNAL
                bool "External SPIRAM"
                default n
                select SPIRAM_ALLOW_STACK_EXTERNAL_MEMORY
                help
                    Enable this option to allocate the task stack from external memory by default
        endmenu

        menu "SSCMA Client Monitor Task"
            config SSCMA_MONITOR_TASK_STACK_SIZE
                int "Stack Size"
                range 4096 10240
                default 4096
                help
                    Config monitor task stack size in different applications

            config SSCMA_MONITOR_TASK_PRIORITY
                int "Task Priority"
                range 1 25
                default 4
                help
                    Sets the monitor task priority

            choice SSCMA_MONITOR_TASK_AFFINITY
                prompt "Core Affinity"
                default SSCMA_MONITOR_TASK_AFFINITY_NO_AFFINTY
                help
                    Configure the "process task" core affinity.

                config SSCMA_MONITOR_TASK_AFFINITY_CPU0
                    bool "CPU0"
                config SSCMA_MONITOR_TASK_AFFINITY_CPU1
                    bool "CPU1"
                    depends on !FREERTOS_UNICORE
                config SSCMA_MONITOR_TASK_AFFINITY_NO_AFFINTY
                    bool "No affinity"
            endchoice

            config SSCMA_MONITOR_TASK_AFFINITY
                int
                default 0 if SSCMA_MONITOR_TASK_AFFINITY_CPU0
                default 1 if SSCMA_MONITOR_TASK_AFFINITY_CPU1
                default -1 if SSCMA_MONITOR_TASK_AFFINITY_NO_AFFINTY


            config SSCMA_MONITOR_TASK_STACK_ALLOC_EXTERNAL
                bool "External SPIRAM"
                default n
                select SPIRAM_ALLOW_STACK_EXTERNAL_MEMORY
                help
                    Enable this option to allocate the task stack from external memory by default
        endmenu

        config SSCMA_ALLOC_SMALL_SHORTTERM_MEM_EXTERNALLY
            bool "Allocate Small but Short-term Heap Memory from External SPIRAM"
                default n
                help
                    Whether to allocate the small but short-term heap mem from external SPIRAM.
                    Enable this in order to optimize the fragmentation of the internal RAM.

    endmenu

endmenu
```

## main/Kconfig.projbuild
```kconfig
menu "Mochi"

    config MOCHI_DEEP_SLEEP_TIMEOUT_SEC
        int "Deep sleep inactivity timeout (seconds)"
        range 30 3600
        default 300
        help
            Seconds of inactivity before the device enters deep sleep.
            Default is 300 (5 minutes).

    config MOCHI_IDLE_AUTO_PLAY_SEC
        int "Idle auto-play interval (seconds)"
        range 5 300
        default 30
        help
            Seconds to wait on the blank screen before auto-playing a random GIF.
            Default is 30.

endmenu
```

## sdkconfig.defaults
```kconfig
CONFIG_IDF_TARGET="esp32s3"

CONFIG_CODEC_I2C_BACKWARD_COMPATIBLE=y
CONFIG_COMPILER_OPTIMIZATION_PERF=y
CONFIG_ESP_DEFAULT_CPU_FREQ_MHZ_240=y
CONFIG_ESP32S3_DATA_CACHE_64KB=y
CONFIG_ESP32S3_DATA_CACHE_LINE_64B=y
CONFIG_ESP32S3_INSTRUCTION_CACHE_32KB=y
CONFIG_BSP_LCD_DEFAULT_BRIGHTNESS=0
CONFIG_ESPTOOLPY_BAUD_921600B=y
CONFIG_ESPTOOLPY_FLASHMODE_QIO=y
CONFIG_ESPTOOLPY_FLASHSIZE_16MB=y
CONFIG_FREERTOS_HZ=1000
CONFIG_FREERTOS_TIMER_TASK_STACK_DEPTH=4096
CONFIG_IDF_EXPERIMENTAL_FEATURES=y
CONFIG_PARTITION_TABLE_CUSTOM=y
CONFIG_SPIRAM_FETCH_INSTRUCTIONS=y
CONFIG_SPIRAM_MALLOC_ALWAYSINTERNAL=256
CONFIG_SPIRAM_MALLOC_RESERVE_INTERNAL=8192
CONFIG_SPIRAM_MODE_OCT=y
CONFIG_SPIRAM_SPEED_80M=y
CONFIG_SPIRAM=y

CONFIG_LV_MEM_CUSTOM=y
CONFIG_LV_COLOR_16_SWAP=y
CONFIG_LV_FONT_MONTSERRAT_24=y
CONFIG_ESP_MAIN_TASK_STACK_SIZE=8192
CONFIG_FATFS_LFN_HEAP=y
CONFIG_FATFS_MAX_LFN=255
CONFIG_LVGL_PORT_TASK_AFFINITY_CPU1=y
CONFIG_LVGL_DRAW_BUFF_HEIGHT=412
CONFIG_ESP_TASK_WDT_CHECK_IDLE_TASK_CPU1=n
CONFIG_LV_USE_GIF=y
CONFIG_LV_USE_FS_POSIX=y
CONFIG_LV_FS_POSIX_LETTER=83
CONFIG_LV_FS_POSIX_PATH="/sdcard"
CONFIG_LV_FS_POSIX_CACHE_SIZE=4096
```
